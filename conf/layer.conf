## conf/layer.conf
```bitbake
# We have a conf and classes directory, add to BBPATH
BBPATH .= ":${LAYERDIR}"

# We have recipes-* directories, add to BBFILES
BBFILES += "${LAYERDIR}/recipes-*/*/*.bb \
            ${LAYERDIR}/recipes-*/*/*.bbappend"

BBFILE_COLLECTIONS += "../layers/meta-godot"
BBFILE_PATTERN_../layers/meta-godot = "^${LAYERDIR}/"
BBFILE_PRIORITY_../layers/meta-godot = "6"
```
